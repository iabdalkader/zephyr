## drivers/wifi/esp_hosted/Kconfig.esp_hosted
```kconfig
# ESP Hosted WiFi driver options

# Copyright (c) 2025 Arduino SA
# SPDX-License-Identifier: Apache-2.0

menuconfig WIFI_ESP_HOSTED
	bool "ESP_HOSTED driver support"
	depends on DT_HAS_ESPRESSIF_ESP_HOSTED_ENABLED
	default y
	select GPIO
	select SPI
	select WIFI_OFFLOAD
	select NET_L2_ETHERNET
	select NET_L2_WIFI_MGMT
	select WIFI_USE_NATIVE_NETWORKING

if WIFI_ESP_HOSTED

config WIFI_ESP_HOSTED_DEBUG
	bool "Enable extra debugging messages"
	help
	  Enable stack debugging messages.

config WIFI_ESP_HOSTED_EVENT_TASK_PRIORITY
	int "Event Task priority"
	default 4

config WIFI_ESP_HOSTED_EVENT_TASK_STACK_SIZE
	int "Event Task Stack Size"
	default 16384

endif
```

## samples/net/wifi/shell/boards/arduino_portenta_c33.conf
```kconfig
# Wi-Fi Configuration
CONFIG_WIFI=y
CONFIG_ZVFS_POLL=y
CONFIG_ZVFS_POLL_MAX=10
CONFIG_WIFI_NM_MAX_MANAGED_INTERFACES=2

# Network Configuration
CONFIG_NET_CONNECTION_MANAGER=y
CONFIG_NET_DHCPV4=y
CONFIG_NET_DHCPV4_SERVER=y
CONFIG_NET_IF_MAX_IPV4_COUNT=3
CONFIG_NET_IF_MAX_IPV6_COUNT=3
CONFIG_NET_IPV4=y
CONFIG_NET_L2_ETHERNET=y
CONFIG_NET_L2_WIFI_MGMT=y
CONFIG_NET_MGMT=y
CONFIG_NET_MGMT_EVENT=y
CONFIG_NET_MGMT_EVENT_INFO=y
CONFIG_NET_MGMT_EVENT_QUEUE_SIZE=32
CONFIG_NET_PKT_RX_COUNT=32
CONFIG_NET_PKT_TX_COUNT=32
CONFIG_NET_TCP=y
CONFIG_NET_UDP=y
CONFIG_NETWORKING=y

# LOG Configuration
CONFIG_NET_LOG=y
CONFIG_LOG_MODE_IMMEDIATE=y
CONFIG_WIFI_LOG_LEVEL_INF=y
CONFIG_NET_DHCPV4_SERVER_LOG_LEVEL_DBG=y

# Debug & misc
CONFIG_DEBUG=y
CONFIG_TEST_RANDOM_GENERATOR=y

# Stack Configuration
CONFIG_IDLE_STACK_SIZE=8192
CONFIG_SHELL_STACK_SIZE=8192
CONFIG_MAIN_STACK_SIZE=8192
CONFIG_HEAP_MEM_POOL_SIZE=65536
CONFIG_NET_MGMT_EVENT_STACK_SIZE=8192
CONFIG_LOG_PROCESS_THREAD_STACK_SIZE=8192
CONFIG_NET_TX_STACK_SIZE=8192
CONFIG_NET_RX_STACK_SIZE=8192
CONFIG_ISR_STACK_SIZE=8192
CONFIG_NET_TCP_WORKQ_STACK_SIZE=8192
CONFIG_SYSTEM_WORKQUEUE_STACK_SIZE=8192
CONFIG_ETH_RA_RX_THREAD_STACK_SIZE=8192
CONFIG_NET_CONNECTION_MANAGER_MONITOR_STACK_SIZE=8192
CONFIG_NET_MGMT_EVENT_MONITOR_STACK_SIZE=8192
CONFIG_NET_SOCKETS_SERVICE_STACK_SIZE=8192
```

## samples/subsys/usb/mass/boards/arduino_giga_r1_m7.conf
```kconfig
#
# SPDX-License-Identifier: Apache-2.0
#
CONFIG_MAIN_STACK_SIZE=8192
CONFIG_COMMON_LIBC_MALLOC_ARENA_SIZE=8192
CONFIG_HEAP_MEM_POOL_SIZE=65536

CONFIG_DISK_ACCESS=y
CONFIG_DISK_DRIVERS=y

CONFIG_FILE_SYSTEM=y
CONFIG_FAT_FILESYSTEM_ELM=y

CONFIG_APP_MSC_STORAGE_SDCARD=y
#CONFIG_SDMMC_STM32_HWFC=y

CONFIG_DISK_DRIVER_FLASH=y

CONFIG_USB_DEVICE_STACK=y
CONFIG_USBD_MSC_STACK_SIZE=8192

#CONFIG_USB_DEVICE_STACK_NEXT=y
#CONFIG_USBD_MSC_SCSI_BUFFER_SIZE=4096

CONFIG_FS_FATFS_CODEPAGE=437
CONFIG_FS_FATFS_EXFAT=n
CONFIG_FS_FATFS_LFN=y
CONFIG_FS_FATFS_LFN_MODE_HEAP=y
CONFIG_FS_FATFS_MIN_SS=512
CONFIG_FS_FATFS_MAX_SS=4096
CONFIG_FS_FATFS_MAX_LFN=255
CONFIG_FS_FATFS_MOUNT_MKFS=n
CONFIG_FS_FATFS_MKFS=y
#CONFIG_FS_FATFS_MULTI_PARTITION=y
CONFIG_FS_FATFS_CUSTOM_MOUNT_POINT_COUNT=2
CONFIG_FS_FATFS_CUSTOM_MOUNT_POINTS="NAND0,NAND1"

CONFIG_MASS_STORAGE_DISK_NAME="NAND1"

CONFIG_DEBUG=y
```
